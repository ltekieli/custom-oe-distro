## meta-custom/conf/distro/tequila.conf
```bitbake
DISTRO_NAME="tequila"
DISTRO_VERSION="2020.12"

SDK_VERSION="tequila.2020.12"

SDKIMAGE_FEATURES += "package-management"

INIT_MANAGER="systemd"

DISTRO_FEATURES_DEFAULT_remove = " alsa bluetooth nfs 3g nfc x11"

DISTRO_FEATURES_BACKFILL_CONSIDERED += "gobject-introspection-data pulseaudio"

EXTRA_IMAGE_FEATURES += "\
    package-management \
    ssh-server-openssh \
"

PACKAGE_CLASSES += "package_ipk"

CORE_IMAGE_EXTRA_INSTALL += "\
    avahi-daemon \
    e2fsprogs-resize2fs \
"

PACKAGE_FEED_URIS = "\
    http://192.168.20.1:8080/ipk \
"

require conf/machine/default.conf
require conf/machine/${MACHINE}-extra.conf
```

## meta-custom/conf/machine/beaglebone-extra.conf
```bitbake
PREFERRED_PROVIDER_virtual/kernel = "linux-ti-next"

CORE_IMAGE_EXTRA_INSTALL += "gadget-init-network"
```

## meta-custom/conf/machine/default.conf
```bitbake
MACHINE_FEATURES:remove =" apm usbhost screen alsa rtc"

MACHINE_FEATURES_BACKFILL_CONSIDERED += "qemu-usermode"

MACHINE_ESSENTIAL_EXTRA_RRECOMMENDS += "kernel-modules"
```

## meta-custom/conf/machine/raspberrypi0-wifi-extra.conf
```bitbake
PREFERRED_PROVIDER_virtual/kernel = "linux-raspberrypi-dev"

DISABLE_SPLASH = "1"
ENABLE_UART = "1"
ENABLE_DWC2_PERIPHERAL = "1"
RPI_USE_U_BOOT = "1"
```
